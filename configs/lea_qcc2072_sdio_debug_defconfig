## configs/lea_qcc2072_sdio_debug_defconfig
```kconfig
include $(WLAN_ROOT)/configs/lea_qcc2072_sdio_perf_defconfig

CONFIG_ALLOW_PKT_DROPPING=y
CONFIG_DP_RX_REFILL_CPU_PERF_AFFINE_MASK=y
CONFIG_DSC_DEBUG=y
CONFIG_DSC_TEST=y
CONFIG_ENABLE_QDF_PTR_HASH_DEBUG=y
CONFIG_FEATURE_HIF_LATENCY_PROFILE_ENABLE=y
CONFIG_FEATURE_UNIT_TEST_SUSPEND=y
CONFIG_HAL_DEBUG=y
CONFIG_HIF_CPU_PERF_AFFINE_MASK=y
CONFIG_LEAK_DETECTION=y
CONFIG_MAX_LOGS_PER_SEC=500
CONFIG_ENABLE_MAX_LOGS_PER_SEC=y
CONFIG_QDF_NBUF_HISTORY_SIZE=16384
CONFIG_SCHED_HISTORY_SIZE=256
CONFIG_REGISTER_OP_DEBUG=y
CONFIG_REO_QDESC_HISTORY=y
CONFIG_TALLOC_DEBUG=y
CONFIG_UNIT_TEST=y
CONFIG_WLAN_RECORD_RX_PADDR=y
CONFIG_QDF_TEST=y
CONFIG_FEATURE_WLM_STATS=y
CONFIG_ENABLE_SCHED_HISTORY_SIZE=y
CONFIG_WLAN_TRACE_HIDE_MAC_ADDRESS_DISABLE=y
CONFIG_ATH_DIAG_EXT_DIRECT=y
CONFIG_DESC_TIMESTAMP_DEBUG_INFO=y
CONFIG_DP_TRACE=y
CONFIG_DP_TRAFFIC_END_INDICATION=y
```
